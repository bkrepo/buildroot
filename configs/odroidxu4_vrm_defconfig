## configs/odroidxu4_vrm_defconfig
```kconfig
# Architecture
BR2_arm=y
BR2_cortex_a7=y
BR2_ARM_EABIHF=y
BR2_ARM_FPU_NEON_VFPV4=y

BR2_TOOLCHAIN_BUILDROOT_CXX=y

BR2_SYSTEM_DHCP="eth0"

# System
BR2_TARGET_GENERIC_HOSTNAME="odroidxu4"
BR2_TARGET_ROOTFS_EXT2=y
BR2_TARGET_ROOTFS_EXT2_4=y
BR2_TARGET_ROOTFS_EXT2_LABEL="rootfs"
BR2_ROOTFS_OVERLAY="board/hardkernel/odroidxu4/rootfs_overlay"
BR2_ROOTFS_POST_IMAGE_SCRIPT="board/hardkernel/odroidxu4/post-image.sh"
BR2_PACKAGE_E2FSPROGS=y
BR2_PACKAGE_E2FSPROGS_RESIZE2FS=y
BR2_GCC_VERSION_4_9_X=y

# Kernel
BR2_KERNEL_HEADERS_VERSION=y
BR2_DEFAULT_KERNEL_VERSION="4.9.30"
BR2_PACKAGE_HOST_LINUX_HEADERS_CUSTOM_4_9=y
BR2_LINUX_KERNEL=y
BR2_LINUX_KERNEL_CUSTOM_GIT=y
BR2_LINUX_KERNEL_CUSTOM_REPO_URL="https://github.com/hardkernel/linux.git"
BR2_LINUX_KERNEL_CUSTOM_REPO_VERSION="0a474c69b8d75f944f5f0b8c5108311ff92ec24d"
BR2_LINUX_KERNEL_DEFCONFIG="odroidxu4"
BR2_LINUX_KERNEL_DTS_SUPPORT=y
BR2_LINUX_KERNEL_BUILD_DEFAULT_DTS=y
BR2_LINUX_KERNEL_USE_INTREE_DTS=y
BR2_LINUX_KERNEL_INTREE_DTS_NAME="exynos5422-odroidxu4"
BR2_LINUX_KERNEL_IMAGE=y

# U-Boot
BR2_TARGET_UBOOT=y
BR2_TARGET_UBOOT_CUSTOM_GIT=y
BR2_TARGET_UBOOT_CUSTOM_REPO_URL="https://github.com/hardkernel/u-boot.git"
BR2_TARGET_UBOOT_CUSTOM_REPO_VERSION="8a47b2602ed2e348ed2a57dc2cd874c4605c538d"
BR2_TARGET_UBOOT_BOARDNAME="odroid"

# ODROID-XU4 specific packages
BR2_PACKAGE_ODROID_FIRMWARE=y
BR2_PACKAGE_ODROID_FIRMWARE_XU4=y

# Required tools to create the SD image
BR2_PACKAGE_HOST_DOSFSTOOLS=y
BR2_PACKAGE_HOST_GENIMAGE=y
BR2_PACKAGE_HOST_MTOOLS=y

# Verium Miner
BR2_PACKAGE_VERIUM_MINER=y

# Management tools
BR2_PACKAGE_OPENSSH=y
BR2_PACKAGE_BUSYBOX_SHOW_OTHERS=y
BR2_PACKAGE_DCRON=y
BR2_PACKAGE_SCREEN=y
BR2_PACKAGE_NTP=y
BR2_TARGET_GENERIC_ROOT_PASSWD="odroid"

# Time Zone
BR2_TARGET_TZ_INFO=y
BR2_TARGET_TZ_ZONELIST="default"
BR2_TARGET_LOCALTIME="Asia/Seoul"
```

## package/odroid-firmware/Config.in
```kconfig
config BR2_PACKAGE_ODROID_FIRMWARE
	bool "odroid-firmware"
	depends on BR2_aarch64 || BR2_arm
	help
	  ODROID Firmware
	  Pre-compiled binaries of the current bootloader

	  https://github.com/hardkernel/u-boot_firmware

if BR2_PACKAGE_ODROID_FIRMWARE

choice
	bool "ODROID Model"
	default BR2_PACKAGE_ODROID_FIRMWARE_XU4
	help
	  Different firmware files by ODROID model:
	    - ODROID-XU4 Firmware

config BR2_PACKAGE_ODROID_FIRMWARE_XU4
	bool "ODROID-XU4"
	depends on BR2_PACKAGE_ODROID_FIRMWARE
	help
	  ODROID-XU4 firmware binaries to boot: bl1, bl2 and tzsw

endchoice

endif # BR2_PACKAGE_ODROID_FIRMWARE
```

## package/verium_miner/Config.in
```kconfig
config BR2_PACKAGE_VERIUM_MINER
	bool "verium_miner"
	select BR2_PACKAGE_ZLIB
	select BR2_PACKAGE_LIBCURL
	select BR2_PACKAGE_OPENSSL
	select BR2_PACKAGE_JANSSON
	help
	  Verium Miner			  

	  https://github.com/effectsToCause/veriumMiner
```
